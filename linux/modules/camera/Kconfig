## linux/modules/camera/drivers/media/Kconfig
```kconfig
#
# Kconfig for Camera drivers
#
source ../modules/camera/drivers/media/pci/Kconfig
source ../modules/camera/drivers/media/i2c/Kconfig
```

## linux/modules/camera/drivers/media/i2c/imx/Kconfig
```kconfig
config VIDEO_IMX
	tristate "sony imx sensor support"
	depends on I2C && VIDEO_V4L2
	---help---
	  This is a Video4Linux2 sensor-level driver for the Sony
	  IMX RAW sensor.

	  It currently depends on internal V4L2 extensions defined in
	  atomisp driver.

choice
	prompt "Select sensor settings"
	depends on VIDEO_IMX

config VIDEO_IMX111
	bool "Sony IMX111 8Mp raw sensor"
	---help---
	  This is sensor driver for Sony IMX111 raw sensor.

	  It currently depends on VIDEO_IMX defined in the above section.
endchoice
```

## linux/modules/camera/drivers/media/i2c/imx219/Kconfig
```kconfig
config VIDEO_IMX
	tristate "sony imx sensor support"
	depends on I2C && VIDEO_V4L2
	---help---
	  This is a Video4Linux2 sensor-level driver for the Sony
	  IMX RAW sensor.

	  It currently depends on internal V4L2 extensions defined in
	  atomisp driver.

choice
	prompt "Select sensor settings"
	depends on VIDEO_IMX

config VIDEO_IMX219
	tristate "Sony IMX219 8Mp raw sensor"
	---help---
	  This is sensor driver for Sony IMX219 raw sensor.

	  It currently depends on VIDEO_IMX defined in the above section.
endchoice
```

## linux/modules/camera/drivers/media/i2c/t4k35_180/Kconfig
```kconfig
config VIDEO_T4K35_180
	tristate "Toshiba t4k35 8Mp raw sensor with Larview module 180 degree rotation"
	depends on I2C && VIDEO_V4L2
	---help---
	  This is a Video4Linux2 sensor-level driver for the Toshiba
	  RAW sensor.

	  It currently depends on internal V4L2 extensions defined in
	  atomisp driver.
```

## linux/modules/drivers/Kconfig
```kconfig
source "../modules/drivers/gpio/Kconfig"
source "../modules/drivers/gps/Kconfig"
source "../modules/drivers/hsi/Kconfig"
source "../modules/drivers/hwmon/Kconfig"
source "../modules/drivers/modem_control/Kconfig"
source "../modules/drivers/misc/Kconfig"
source "../modules/drivers/i2c/busses/Kconfig"
source "../modules/drivers/input/Kconfig"
source "../modules/drivers/leds/Kconfig"
source "../modules/drivers/nfc/Kconfig"
source "../modules/drivers/power/Kconfig"
source "../modules/drivers/staging/Kconfig"
source "../modules/drivers/pinctrl/Kconfig"
source "../modules/drivers/platform/x86/Kconfig"
source "../modules/drivers/regulator/Kconfig"
source "../modules/drivers/switch/Kconfig"
source "../modules/drivers/hsu/Kconfig"
source "../modules/drivers/mfd/Kconfig"
source "../modules/drivers/net/wireless/bcm43xx/Kconfig"
```

## linux/modules/drivers/gps/Kconfig
```kconfig
menuconfig GPS
	bool "Gps Adapters"
	default n
	---help---
	  Say Y here to enable selecting GPS adapters.

if GPS

# Intel MID GPS
source "../modules/drivers/gps/intel_mid_gps/Kconfig"

# TI's ST based wl128x GPS
source "../modules/drivers/gps/wl128x/Kconfig"

endif # GPS
```

## linux/modules/drivers/i2c/busses/Kconfig
```kconfig
#
# I2C buses device configuration
#

config I2C_DESIGNWARE_PCI_FORK
	tristate "Synopsys DesignWare PCI"
	depends on PCI
	help
	  If you say yes to this option, support will be included for the
	  Synopsys DesignWare I2C adapter. Only master mode is supported.

	  This driver can also be built as a module.  If so, the module
	  will be called i2c-designware-pci.

config I2C_PMIC
	bool "PMIC I2C Adapter"
	depends on INTEL_SCU_IPC
	help
	  Say Y here if you have PMIC I2C adapter.

	  PMIC-I2C adapter driver to handle I2C transactions
	  in the PMIC's I2C bus.
```

## linux/modules/drivers/input/Kconfig
```kconfig
source "../modules/drivers/input/touchscreen/Kconfig"
source "../modules/drivers/input/misc/Kconfig"
```

## linux/modules/drivers/nfc/Kconfig
```kconfig
#
# Near Field Communication (NFC) devices
#

config PN544_NFC_FORK
	tristate "Forked PN544 NFC driver"
	depends on I2C && !PN544_NFC
	select CRC_CCITT
	default n
	---help---
	  Say yes if you want forked PN544 Near Field Communication driver.
	  This is for i2c connected version. If unsure, say N here.

	  To compile this driver as a module, choose m here. The module will
	  be called pn544.
```
